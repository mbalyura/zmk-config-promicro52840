## boards/shields/promicro52840/Kconfig.defconfig
```kconfig
if SHIELD_PROMICRO52840

config ZMK_KEYBOARD_NAME
	default "promicro52840"

config ZMK_USB
	default y

config GPIO
	default y

config ZMK_KSCAN_DIRECT_POLLING
	bool "Enable direct polling for kscan"
	default y

endif
```
